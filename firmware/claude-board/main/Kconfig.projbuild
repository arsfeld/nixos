## firmware/claude-board/main/Kconfig.projbuild
```kconfig
menu "Claude board"

    config CLAUDE_BOARD_WIFI_SSID
        string "Wi-Fi SSID"
        default ""
        help
            Compiled in. `just board creds` fills it from sops (sdkconfig.defaults.local).

    config CLAUDE_BOARD_WIFI_PASS
        string "Wi-Fi password"
        default ""

    config CLAUDE_BOARD_TOKEN
        string "Device token for the bridge"
        default ""

    config CLAUDE_BOARD_URL
        string "Bridge WebSocket URL"
        default "wss://claude-board.arsfeld.one/v1/board"
        help
            Only wss:// is supported: the server certificate is always validated against the
            ESP-IDF certificate bundle, and there is no option to skip that.

    config CLAUDE_BOARD_NTP_SERVER
        string "NTP server"
        default "pool.ntp.org"
        help
            The clock must be set before any TLS connection (certificate validity). If it cannot
            be set the board does not connect.

    config CLAUDE_BOARD_DNS
        string "DNS server override (empty = use DHCP's)"
        default ""
        help
            For networks whose DNS cannot be trusted or resolves the bridge's name to a LAN address.

    config CLAUDE_BOARD_SNAPSHOT
        bool "Debug: log a downscaled screenshot over serial after each UI change"
        default n
        help
            Lets the screens be inspected without looking at the board. Off in real builds.

    config CLAUDE_BOARD_SELFTEST
        bool "Debug: click the UI's own buttons (questions, cards, back) every few seconds"
        default n
        help
            Drives the real button handlers without a finger, to test the answer path end to end.
            Off in real builds.

endmenu
```
